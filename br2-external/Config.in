## br2-external/Config.in
```kconfig
source "$BR2_EXTERNAL_FOOBAR_PATH/package/bar/Config.in"
source "$BR2_EXTERNAL_FOOBAR_PATH/package/libfoo/Config.in"
source "$BR2_EXTERNAL_FOOBAR_PATH/package/myapp/Config.in"
```

## br2-external/configs/bootlin_defconfig
```kconfig
BR2_arm=y
BR2_cortex_a7=y
BR2_TOOLCHAIN_EXTERNAL=y
BR2_TOOLCHAIN_EXTERNAL_BOOTLIN=y
BR2_GLOBAL_PATCH_DIR="$(BR2_EXTERNAL_FOOBAR_PATH)/board/bootlin/stm32mp1/patches/"
BR2_TARGET_GENERIC_HOSTNAME="stm32mp1-dk1"
BR2_TARGET_GENERIC_ISSUE="Welcome to the STM32MP157 Buildroot system"
BR2_ROOTFS_OVERLAY="$(BR2_EXTERNAL_FOOBAR_PATH)/board/bootlin/stm32mp1/rootfs-overlay"
BR2_ROOTFS_POST_BUILD_SCRIPT="$(BR2_EXTERNAL_FOOBAR_PATH)/board/bootlin/stm32mp1/build_id_creator.sh"
BR2_ROOTFS_POST_IMAGE_SCRIPT="$(BR2_EXTERNAL_FOOBAR_PATH)/board/bootlin/stm32mp1/genimage.sh"
BR2_ROOTFS_POST_SCRIPT_ARGS="-c $(BR2_EXTERNAL_FOOBAR_PATH)/board/bootlin/stm32mp1/genimage.cfg"
BR2_LINUX_KERNEL=y
BR2_LINUX_KERNEL_CUSTOM_VERSION=y
BR2_LINUX_KERNEL_CUSTOM_VERSION_VALUE="6.12.47"
BR2_LINUX_KERNEL_USE_CUSTOM_CONFIG=y
BR2_LINUX_KERNEL_CUSTOM_CONFIG_FILE="$(BR2_EXTERNAL_FOOBAR_PATH)/board/bootlin/stm32mp1/linux-stm32mp1.config"
BR2_LINUX_KERNEL_DTS_SUPPORT=y
BR2_LINUX_KERNEL_INTREE_DTS_NAME="st/stm32mp157a-dk1"
BR2_LINUX_KERNEL_INSTALL_TARGET=y
BR2_LINUX_KERNEL_NEEDS_HOST_OPENSSL=y
BR2_PACKAGE_NINVADERS=y
BR2_PACKAGE_EVTEST=y
BR2_PACKAGE_LIBCONFIG=y
BR2_PACKAGE_DROPBEAR=y
BR2_TARGET_ROOTFS_EXT2=y
BR2_TARGET_ROOTFS_EXT2_4=y
BR2_TARGET_UBOOT=y
BR2_TARGET_UBOOT_BUILD_SYSTEM_KCONFIG=y
BR2_TARGET_UBOOT_CUSTOM_VERSION=y
BR2_TARGET_UBOOT_CUSTOM_VERSION_VALUE="2025.07"
BR2_TARGET_UBOOT_BOARD_DEFCONFIG="stm32mp15_basic"
BR2_TARGET_UBOOT_NEEDS_PYLIBFDT=y
BR2_TARGET_UBOOT_FORMAT_IMG=y
BR2_TARGET_UBOOT_SPL=y
BR2_TARGET_UBOOT_SPL_NAME="u-boot-spl.stm32"
BR2_TARGET_UBOOT_CUSTOM_MAKEOPTS="DEVICE_TREE=st/stm32mp157a-dk1"
BR2_PACKAGE_HOST_GENIMAGE=y
BR2_PACKAGE_BAR=y
BR2_PACKAGE_LIBFOO_DEBUG=y
```

## br2-external/package/bar/Config.in
```kconfig
config BR2_PACKAGE_BAR
    bool "bar"
    select BR2_PACKAGE_LIBFOO
    help
        A completely stupid and useless application
        https://bootlin.com/~thomas/bar/
```

## br2-external/package/libfoo/Config.in
```kconfig
config BR2_PACKAGE_LIBFOO
    bool "libfoo"
    help
        This is a completely stupid piece of source code doing absolutely nothing useful. 
        It is only intended to be used as an exercice for packaging software in Buildroot.
        https://github.com/tpetazzoni/libfoo
    
if BR2_PACKAGE_LIBFOO
    config BR2_PACKAGE_LIBFOO_DEBUG
        bool "enable debug feature"
        help
            Enable the debug feature of libfoo.
endif
```

## br2-external/package/myapp/Config.in
```kconfig
config BR2_PACKAGE_MYAPP
    bool "myapp"
    select BR2_PACKAGE_MYAPP
    help
        A completely stupid and useless application
```

## package/ninvaders/Config.in
```kconfig
config BR2_PACKAGE_NINVADERS
    bool "ninvaders"
    select BR2_PACKAGE_NCURSES
    help
        space invaders game
        https://ninvaders.sourceforge.net/
```
